## Documentation/devicetree/bindings/crypto/axera,ax630c-eip130.yaml
```yaml
# SPDX-License-Identifier: GPL-2.0-only OR BSD-2-Clause
%YAML 1.2
---
$id: http://devicetree.org/schemas/crypto/axera,ax630c-eip130.yaml#
$schema: http://devicetree.org/meta-schemas/core.yaml#

title: Axera AX630C public EIP-130 cryptographic engine

maintainers:
  - OneKVM <dev@onekvm.org>

description: |
  The public mailbox engine performs DMA independently of the CPU's optional
  cryptographic instruction set. Mailbox 2 is used for Linux requests and
  mailbox 1 for loading the vendor firmware. The secure-world engine must
  not be described by this binding.

properties:
  compatible:
    const: axera,ax630c-eip130

  reg:
    maxItems: 1

  interrupts:
    maxItems: 1

  clocks:
    items:
      - description: APB interface clock
      - description: AXI and core clock
      - description: Counter clock

  clock-names:
    items:
      - const: pclk
      - const: core
      - const: cnt

  resets:
    items:
      - description: Main memory access manager reset
      - description: Counter reset
      - description: Core soft reset
      - description: APB interface reset
      - description: AXI master reset

required:
  - compatible
  - reg
  - interrupts
  - clocks
  - clock-names
  - resets

additionalProperties: false
```

## Documentation/devicetree/bindings/media/axera,ax630c-tdp.yaml
```yaml
# SPDX-License-Identifier: (GPL-2.0-only OR BSD-2-Clause)
%YAML 1.2
---
$id: http://devicetree.org/schemas/media/axera,ax630c-tdp.yaml#
$schema: http://devicetree.org/meta-schemas/core.yaml#

title: Axera AX630C two-dimensional image processor

maintainers:
  - OneKVM maintainers <dev@onekvm.org>

description: |
  The TDP scales images and converts their colour space independently of
  the VIN capture and Hantro video encoder. It has one completion interrupt.
  CPU register submission does not require the shared CDMA engine clocks
  or resets. Reset lines are private to the TDP peripheral and core.

properties:
  compatible:
    const: axera,ax630c-tdp
  reg:
    maxItems: 1
  interrupts:
    maxItems: 1
  clocks:
    items:
      - description: TDP core clock
      - description: TDP peripheral clock
  clock-names:
    items:
      - const: core
      - const: pclk
  assigned-clocks:
    maxItems: 1
  assigned-clock-rates:
    maxItems: 1
  resets:
    items:
      - description: TDP peripheral reset
      - description: TDP core reset

required:
  - compatible
  - reg
  - interrupts
  - clocks
  - clock-names
  - resets

additionalProperties: false
```

## Documentation/devicetree/bindings/media/axera,ax630c-vdec.yaml
```yaml
# SPDX-License-Identifier: (GPL-2.0-only OR BSD-2-Clause)
%YAML 1.2
---
$id: http://devicetree.org/schemas/media/axera,ax630c-vdec.yaml#
$schema: http://devicetree.org/meta-schemas/core.yaml#

title: Axera AX630C Hantro G1 video decoder

maintainers:
  - OneKVM maintainers <dev@onekvm.org>

description: |
  Hantro G1 H.264 decoder exposed through V4L2 stateless decoding and the
  Media Request API. The peripheral has a private clock and reset; VIN,
  VENC and the shared CDMA domains are managed independently.

properties:
  compatible:
    const: axera,ax630c-vdec
  reg:
    maxItems: 1
  reg-names:
    items:
      - const: ax_vdec
  interrupts:
    maxItems: 1
  clocks:
    maxItems: 1
  clock-names:
    items:
      - const: vdec_clk
  resets:
    maxItems: 1
  reset-names:
    items:
      - const: vdec_rst
  operating-points-v2: true

required:
  - compatible
  - reg
  - interrupts
  - clocks
  - resets

additionalProperties: false
```

## Documentation/devicetree/bindings/watchdog/axera,ax620e-wdt.yaml
```yaml
# SPDX-License-Identifier: (GPL-2.0-only OR BSD-2-Clause)
%YAML 1.2
---
$id: http://devicetree.org/schemas/watchdog/axera,ax620e-wdt.yaml#
$schema: http://devicetree.org/meta-schemas/core.yaml#

title: Axera AX620E and AX630C hardware watchdog

maintainers:
  - OneKVM maintainers <dev@onekvm.org>

description: |
  The Axera watchdog has a 32-bit down counter with a 16-bit reload field
  representing multiples of 65536 reference clock ticks. The first expiry
  reloads the counter and latches an interrupt; the second resets the system.
  The driver accounts for both stages in the watchdog timeout. It can use the
  low frequency RTC clock or the 24 MHz oscillator. The timer and bus have
  separate clocks and resets. This binding uses hardware reset on expiry;
  the optional interrupt is not used for automatic keepalive.

allOf:
  - $ref: watchdog.yaml#

properties:
  compatible:
    const: axera,ax620e-wdt
  reg:
    maxItems: 1
  clocks:
    items:
      - description: Timer reference clock
      - description: Peripheral bus clock
  clock-names:
    items:
      - const: tclk
      - const: pclk
  resets:
    items:
      - description: Timer reset
      - description: Peripheral bus reset
  reset-names:
    items:
      - const: timer
      - const: bus

required:
  - compatible
  - reg
  - clocks
  - clock-names
  - resets
  - reset-names

unevaluatedProperties: false
```

## arch/arm/mach-axera/Kconfig
```kconfig
# SPDX-License-Identifier: GPL-2.0-only

menuconfig ARCH_AXERA
	bool "Axera SoC Support"
	depends on ARCH_MULTI_V7
	select ARM_GIC
	select HAVE_ARM_ARCH_TIMER
	select NO_IOPORT_MAP
	help
	  Support for Axera AX620E family SoCs such as AX620Q.

if ARCH_AXERA

config ARCH_AX620E
	bool "Axera AX620X family"
	default y
	help
	  Support for Axera AX620E SoC family.

endif
```

## arch/arm64/configs/ax630c_nanokvm_pro_defconfig
```kconfig
# NanoKVM Pro (AX630C): serial, JLSemi GMAC, NFS root, eMMC, USB host storage.
# Board defconfig, not arch/arm64/configs/defconfig. No PARAVIRT/KVM, no Realtek PHY.
# CONFIG_LOCALVERSION_AUTO is not set
CONFIG_MODULES=y
CONFIG_SYSVIPC=y
# CONFIG_CROSS_MEMORY_ATTACH is not set
# CONFIG_CPU_ISOLATION is not set
CONFIG_IKCONFIG=y
CONFIG_IKCONFIG_PROC=y
CONFIG_CGROUPS=y
CONFIG_MEMCG=y
CONFIG_CGROUP_PIDS=y
CONFIG_CGROUP_DEVICE=y
CONFIG_CGROUP_CPUACCT=y
# CONFIG_TIME_NS is not set
CONFIG_ARCH_AXERA=y
# CONFIG_AMPERE_ERRATUM_AC03_CPU_38 is not set
# CONFIG_AMPERE_ERRATUM_AC04_CPU_23 is not set
# CONFIG_ARM64_ERRATUM_832075 is not set
# CONFIG_ARM64_ERRATUM_1024718 is not set
# CONFIG_ARM64_ERRATUM_1165522 is not set
# CONFIG_ARM64_ERRATUM_1319367 is not set
# CONFIG_ARM64_ERRATUM_1530923 is not set
# CONFIG_ARM64_ERRATUM_1463225 is not set
# CONFIG_ARM64_ERRATUM_1508412 is not set
# CONFIG_ARM64_ERRATUM_2051678 is not set
# CONFIG_ARM64_ERRATUM_2077057 is not set
# CONFIG_ARM64_ERRATUM_2658417 is not set
# CONFIG_ARM64_ERRATUM_2054223 is not set
# CONFIG_ARM64_ERRATUM_2067961 is not set
# CONFIG_ARM64_ERRATUM_2645198 is not set
# CONFIG_ARM64_ERRATUM_2966298 is not set
# CONFIG_ARM64_ERRATUM_3117295 is not set
# CONFIG_ARM64_ERRATUM_3194386 is not set
# CONFIG_ARM64_ERRATUM_4118414 is not set
# CONFIG_CAVIUM_ERRATUM_22375 is not set
# CONFIG_CAVIUM_ERRATUM_23154 is not set
# CONFIG_CAVIUM_ERRATUM_27456 is not set
# CONFIG_CAVIUM_ERRATUM_30115 is not set
# CONFIG_CAVIUM_TX2_ERRATUM_219 is not set
# CONFIG_FUJITSU_ERRATUM_010001 is not set
# CONFIG_HISILICON_ERRATUM_161600802 is not set
# CONFIG_HISILICON_ERRATUM_162100801 is not set
# CONFIG_QCOM_FALKOR_ERRATUM_1003 is not set
# CONFIG_QCOM_FALKOR_ERRATUM_1009 is not set
# CONFIG_QCOM_QDF2400_ERRATUM_0065 is not set
# CONFIG_QCOM_FALKOR_ERRATUM_E1041 is not set
# CONFIG_NVIDIA_CARMEL_CNP_ERRATUM is not set
# CONFIG_ROCKCHIP_ERRATUM_3568002 is not set
# CONFIG_ROCKCHIP_ERRATUM_3588001 is not set
# CONFIG_SOCIONEXT_SYNQUACER_PREITS is not set
CONFIG_NR_CPUS=4
CONFIG_HOTPLUG_CPU=y
# A53 r0p4 has no LPA2. 52-bit VA falls back at boot and breaks user page tables.
CONFIG_ARM64_4K_PAGES=y
CONFIG_ARM64_VA_BITS_48=y
# CONFIG_ARM64_VA_BITS_52 is not set
CONFIG_ARM64_PA_BITS_48=y
# CONFIG_ARM64_PA_BITS_52 is not set
# CONFIG_ARM64_TAGGED_ADDR_ABI is not set
# CONFIG_ARM64_HW_AFDBM is not set
# CONFIG_ARM64_PAN is not set
# CONFIG_ARM64_USE_LSE_ATOMICS is not set
# CONFIG_ARM64_RAS_EXTN is not set
# CONFIG_ARM64_CNP is not set
# CONFIG_ARM64_PTR_AUTH is not set
# CONFIG_ARM64_AMU_EXTN is not set
# CONFIG_ARM64_TLB_RANGE is not set
# CONFIG_ARM64_BTI is not set
# CONFIG_ARM64_E0PD is not set
# CONFIG_ARM64_POE is not set
# CONFIG_ARM64_GCS is not set
# CONFIG_ARM64_SVE is not set
# CONFIG_EFI is not set
# CONFIG_SUSPEND is not set
CONFIG_PM=y
# CONFIG_SCHED_SMT is not set
# CONFIG_SCHED_CLUSTER is not set
# CONFIG_SCHED_MC is not set
# CONFIG_SECCOMP is not set
# CONFIG_STACKPROTECTOR is not set
# CONFIG_RELR is not set
# CONFIG_BLOCK_LEGACY_AUTOLOAD is not set
# CONFIG_BLK_DEV_WRITE_MOUNTED is not set
# CONFIG_MQ_IOSCHED_DEADLINE is not set
# CONFIG_MQ_IOSCHED_KYBER is not set
# CONFIG_IOSCHED_BFQ is not set
# CONFIG_SWAP is not set
# CONFIG_SLAB_MERGE_DEFAULT is not set
# CONFIG_SLUB_CPU_PARTIAL is not set
# CONFIG_COMPAT_BRK is not set
# CONFIG_COMPACTION is not set
# CONFIG_MIGRATION is not set
CONFIG_NET=y
CONFIG_PACKET=y
CONFIG_UNIX=y
CONFIG_INET=y
CONFIG_IP_PNP=y
CONFIG_IP_PNP_DHCP=y
CONFIG_IP_PNP_BOOTP=y
CONFIG_IP_PNP_RARP=y
# CONFIG_IPV6 is not set
# CONFIG_WIRELESS is not set
CONFIG_DEVTMPFS=y
CONFIG_DEVTMPFS_MOUNT=y
# CONFIG_STANDALONE is not set
# CONFIG_PREVENT_FIRMWARE_BUILD is not set
# CONFIG_ARM_SMCCC_SOC_ID is not set
CONFIG_SCSI=y
CONFIG_BLK_DEV_SD=y
CONFIG_NETDEVICES=y
CONFIG_STMMAC_ETH=y
# CONFIG_DWMAC_GENERIC is not set
CONFIG_JLSEMI_PHY=y
# CONFIG_WLAN is not set
CONFIG_INPUT=y
CONFIG_INPUT_EVDEV=y
# CONFIG_INPUT_MOUSE is not set
# CONFIG_INPUT_TOUCHSCREEN is not set
CONFIG_INPUT_KEYBOARD=y
CONFIG_KEYBOARD_GPIO=y
# CONFIG_KEYBOARD_ATKBD is not set
# CONFIG_KEYBOARD_GPIO_POLLED is not set
CONFIG_INPUT_MISC=y
CONFIG_INPUT_GPIO_ROTARY_ENCODER=y
# CONFIG_SERIO is not set
# CONFIG_LEGACY_PTYS is not set
# CONFIG_LEGACY_TIOCSTI is not set
# CONFIG_LDISC_AUTOLOAD is not set
CONFIG_SERIAL_8250=y
CONFIG_SERIAL_8250_CONSOLE=y
CONFIG_SERIAL_8250_DW=y
CONFIG_SERIAL_OF_PLATFORM=y
# CONFIG_HW_RANDOM is not set
# CONFIG_DEVMEM is not set
# CONFIG_DEVPORT is not set
# CONFIG_PTP_1588_CLOCK_KVM is not set
CONFIG_PINCTRL_AXERA=y
# CONFIG_HWMON is not set
# CONFIG_HID_SUPPORT is not set
CONFIG_USB=y
CONFIG_USB_XHCI_HCD=y
CONFIG_USB_STORAGE=y
CONFIG_USB_DWC3=y
# CONFIG_USB_DWC3_OF_SIMPLE is not set
# CONFIG_USB_DWC3_GENERIC_PLAT is not set
CONFIG_MMC=y
CONFIG_MMC_SDHCI=y
CONFIG_MMC_SDHCI_PLTFM=y
CONFIG_MMC_SDHCI_CADENCE=y
# CONFIG_VIRTIO_MENU is not set
# CONFIG_VHOST_MENU is not set
# CONFIG_SURFACE_PLATFORMS is not set
# CONFIG_ARM64_PLATFORM_DEVICES is not set
# CONFIG_ARM_ARCH_TIMER_EVTSTREAM is not set
# CONFIG_FSL_ERRATUM_A008585 is not set
# CONFIG_HISILICON_ERRATUM_161010101 is not set
# CONFIG_ARM64_ERRATUM_858921 is not set
# CONFIG_IOMMU_SUPPORT is not set
CONFIG_EXT4_FS=y
# CONFIG_EXT4_USE_FOR_EXT2 is not set
# CONFIG_DNOTIFY is not set
CONFIG_VFAT_FS=y
CONFIG_TMPFS=y
# CONFIG_MISC_FILESYSTEMS is not set
CONFIG_NFS_FS=y
CONFIG_ROOT_NFS=y
CONFIG_NLS_CODEPAGE_437=y
CONFIG_NLS_ISO8859_1=y
CONFIG_PRINTK_TIME=y
# CONFIG_SYMBOLIC_ERRNAME is not set
# CONFIG_SECTION_MISMATCH_WARN_ONLY is not set
# CONFIG_RUNTIME_TESTING_MENU is not set

# Desk JD9853 and the ATX OLED are optional display modules. The ATX OLED
# has no device-tree node yet, so its module remains unloaded on that board.
CONFIG_SPI=y
CONFIG_SPI_MASTER=y
CONFIG_SPI_DESIGNWARE=y
CONFIG_SPI_DW_MMIO=y
CONFIG_I2C=y
CONFIG_I2C_DESIGNWARE_CORE=y
CONFIG_I2C_DESIGNWARE_PLATFORM=y
CONFIG_BACKLIGHT_CLASS_DEVICE=y
CONFIG_PWM=y
CONFIG_PWM_GPIO=y
CONFIG_BACKLIGHT_PWM=y
CONFIG_FB=y
CONFIG_FB_DEVICE=y
CONFIG_STAGING=y
CONFIG_FB_TFT=m
CONFIG_FB_TFT_JD9853=m
CONFIG_FB_SSD1307=m
# CONFIG_FRAMEBUFFER_CONSOLE is not set
```

## drivers/crypto/axera/Kconfig
```kconfig
config CRYPTO_DEV_AXERA_EIP130
	tristate "Axera AX620E/AX630C EIP-130 AES engine"
	depends on ARCH_AXERA || COMPILE_TEST
	depends on OF && HAS_DMA
	select CRYPTO_ENGINE
	select CRYPTO_SKCIPHER
	help
	  Interrupt driven AES ECB/CBC/CTR using the EIP-130 mailbox engine.
	  With HW_RANDOM enabled, also registers the EIP-130 TRNG as a
	  hardware random number generator.
	  Requires axera/eip130.bin firmware. Standard Crypto API templates
	  can combine the hardware CTR implementation with software GHASH.
	  This driver does not expose physical addresses or raw tokens to userspace.
```

## sound/soc/axera/Kconfig
```kconfig
# SPDX-License-Identifier: GPL-2.0-only
config SND_SOC_AX630C_HDMI
	tristate "AX630C HDMI I2S capture"
	depends on OF && (ARCH_AXERA || COMPILE_TEST)
	depends on DMA_ENGINE
	select SND_SOC_GENERIC_DMAENGINE_PCM
	help
	  Capture stereo PCM from the LT6911 HDMI bridge via the AX630C
	  I2S slave (RX1) and peripheral DMA. Initial format: 48kHz S16_LE.
```
